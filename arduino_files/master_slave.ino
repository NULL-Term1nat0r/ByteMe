#include <Wire.h>
#include <string>
#define SLAVE_ADDRESS 1

int sensorPin = A1; 
int wantRequest = 0;

enum class ModuleState {
  // Startup state; the module is expected to send the initial
  // 20 bytes of the sensor auth descriptor
  NotConnected,

  // The module has sent the first 20 bytes of its auth
  // descriptor; any request in this state is expected to
  // stream the remaining descriptor bytes to the mainboard
  SendAuthChunks,

  // All bytes of the descriptor have been sent; in this state
  // the module is expected to send its current measurement
  // values in 32-byte chunks
  Connected
};

const static uint8_t g_authDescriptor[] = {
  0x42, 0x79, 0x74, 0x65, 0x4d, 0x65, 0xff, 0x41, 0x75, 0x64, 0x69, 0x00,
  0xea, 0x03, 0x00, 0x00, 0x96, 0x02, 0x00, 0x00, 0x03, 0x0c, 0x30, 0x02,
  0x00, 0xf1, 0x2f, 0xf7, 0x04, 0x04, 0x66, 0x4e, 0x97, 0x8f, 0x2c, 0x1b,
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  0x74, 0x79
  // TODO: Populate using the script
};

static ModuleState g_state = ModuleState::NotConnected;
static uint32_t g_authChunkOffset;

static void requestHandler() {
  if (g_state != ModuleState::Connected)
  {
  switch (g_state) {
    case ModuleState::NotConnected:
      Wire.write(&g_authDescriptor[0], 20);
      g_state = ModuleState::SendAuthChunks;
      g_authChunkOffset = 20;
      break;
    case ModuleState::SendAuthChunks:
      if (sizeof(g_authDescriptor) - g_authChunkOffset <= 32) {
        Wire.write(&g_authDescriptor[g_authChunkOffset],
          (size_t)(sizeof(g_authDescriptor) - g_authChunkOffset));
        g_state = ModuleState::Connected;
        g_authChunkOffset = sizeof(g_authDescriptor);
      } else {
        Wire.write(&g_authDescriptor[g_authChunkOffset], 32);
        g_authChunkOffset += 32;
      }
      break;
    case ModuleState::Connected:
      break;
  }
  else
      int wantRequest = 1;

}


 void receiveEvent(int data) {
  while (Wire.available()) { 
    char c = Wire.read(); 
    Serial.print(c);   
    }        // print the character
  }

// void requestEvent(){

//   // Wire.write("test1\0", 6);

//       // Aktueller Spannungswert wird gemessen...
//     int rawValue = analogRead(sensorPin);
//     float voltage = rawValue * (5.0/1023) * 1000;
         
//     float resitance = 10000 * ( voltage / ( 5000.0 - voltage) );
         
//     // ... und hier auf die serielle Schnittstelle ausgegeben
//     Serial.print("Spannungswert:"); Serial.print(voltage); Serial.print("mV");
//     Serial.print(", Widerstandswert:"); Serial.print(resitance); Serial.println("Ohm");
//     Serial.println("---------------------------------------");
//     Wire.write((uint8_t *)&voltage, sizeof(float));

// }

class Value
{
  public:
        float a;
        float b;
        float c;
        float d;
};

void setup()
{
  Wire.begin(1);               
  Wire.onReceive(receiveEvent);             
  Wire.onRequest(requestHandler);   
}

void sendSensorData(){

}
void loop()
{  
   while(wantRequest == 1)
  {
    int rawValue = analogRead(sensorPin);
    float voltage = rawValue * (5.0/1023) * 1000;
         
    float resitance = 10000 * ( voltage / ( 5000.0 - voltage) );
         
    // ... und hier auf die serielle Schnittstelle ausgegeben
    Serial.print("Spannungswert:"); Serial.print(voltage); Serial.print("mV");
    Serial.print(", Widerstandswert:"); Serial.print(resitance); Serial.println("Ohm");
    Serial.println("---------------------------------------");
    Value value;
    value.a = rawValue * (5.0/1023) * 1000;
    value.b = rawValue * (5.0/1023) * 1000;
    value.c = rawValue * (5.0/1023) * 1000;
    value.d = rawValue * (5.0/1023) * 1000;

    Wire.write((uint8_t *)&value, sizeof(Value));

    wantRequest = 0;
  }
  delay(1000);
      
}
 
